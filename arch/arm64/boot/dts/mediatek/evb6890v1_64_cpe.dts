// SPDX-License-Identifier: GPL-2.0
/*
 * Copyright (c) 2019 MediaTek Inc.
 */

/dts-v1/;
#include <dt-bindings/interrupt-controller/irq.h>
#include <dt-bindings/interrupt-controller/arm-gic.h>
#include "mt6890.dtsi"
#include "tcpc_config.dtsi"
#include "rt9467.dtsi"

&reserved_memory {
};

/ {
	model = "AW1000_Ultra";
	compatible = "mediatek,evb6890v1_64_cpe", "mediatek,mt6890", "telstra,meteor2";

	ptn5150a_typec: ptn5150a_type_c_port0 {
		tcpc-dual,supported_modes = <0>;
		rt-tcpc,name = "type_c_port0";
		rt-tcpc,role_def = <4>;
		rt-tcpc,rp_level = <0>;
		rt-tcpc,vconn_supply = <1>;
		rt-tcpc,notifier_supply_num = <2>;

		ptn5150a,intr_gpio = <&pio 21 0>;
		ptn5150a,pwr_gpio = <&pio 41 0>;
	};

	memory@40000000 {
		device_type = "memory";
		reg = <0 0x40000000 0 0x1e800000>;
	};

	chosen {
		bootargs = "console=tty0 console=ttyS0,921600n1 \
		init=/etc/preinit root=/dev/mmcblk0p32 mmcdev=179:14 rootwait \
		loglevel=8 mtdpath=/dev/mmcblk0p14 \
		androidboot.selinux=permissive androidboot.hardware=mt6890 \
		initcall_debug=1 page_owner=on";

		atag,videolfb-fb_base_l = <0x7e605000>;
		atag,videolfb-fb_base_h = <0x0>;
		atag,videolfb-islcmfound = <1>;
		atag,videolfb-islcm_inited = <0>;
		atag,videolfb-fps= <6000>;
		atag,videolfb-vramSize= <0x1be0000>;
		atag,videolfb-lcmname=
			"nt35595_fhd_dsi_cmd_truly_nt50358_drv";
	};

	gsw: gsw@0 {
		compatible = "mediatek,mt753x";
		mediatek,ethsys = <&ethsys>;
		#address-cells = <1>;
		#size-cells = <0>;
	};

	subpmic_pmu_eint: subpmic_pmu_eint {
	};

	tcpc_pd: tcpc_pd_eint {
	};
};

/* BEGIN: Remove unused device tree information,modify by haowei.cheng*/
#if 0
&snps_mac {
	phy-mode ="rgmii-rxid";
	phy-handle = <&eth_phy0>;
	status = "disable";
	pinctrl-names = "default", "sleep";
	pinctrl-0 = <&eth_default>;
	pinctrl-1 = <&eth_sleep>;
	snps,reset-gpio = <&pio 24 GPIO_ACTIVE_LOW>;
	snps,reset-active-low;
	mdio {
		compatible = "snps,dwmac-mdio";
		#address-cells = <1>;
		#size-cells = <0>;
		eth_phy0: eth_phy0@5 {
			compatible = "ethernet-phy-ieee802.3-c22";
		};
		eth_phy1: eth_phy1@7 {
			compatible = "ethernet-phy-ieee802.3-c45";
			marvell,88q2110 = <1000 0>;
		};
		eth_phy2: eth_phy2@4 {
			compatible = "ethernet-phy-id0180.DD00";
		};
	};
};
#endif
/* END: Remove unused device tree information,modify by haowei.cheng */


/* BEGIN: support realtek eth phy,modify by haowei.cheng*/
&eth {
	pinctrl-names = "eth_gpio_default",
		"eth_smi_mdio_pinctl",
		"eth_smi_mdc_pinctl";
	pinctrl-0 = <&eth_gpio_default>;
	pinctrl-1 = <&eth_smi_mdio_pinctl>;
	pinctrl-2 = <&eth_smi_mdc_pinctl>;
	status = "okay";
	gmac0: mac@0 {
		compatible = "mediatek,eth-mac";
		fg360,phy_name = "aqr112c";
		reg = <0>;
		phy-mode = "sgmii";
		phy-handle = <&phy8>;
	};
	gmac1: mac@1 {
		compatible = "mediatek,eth-mac";
		reg = <1>;
		fg360,phy_name = "mt7531AE";
		phy-mode = "sgmii";
		fixed-link {
			speed = <1000>;
			full-duplex;
			pause;
		};
	};
	gmac3: mac@3 {
		compatible = "mediatek,eth-mac";
		fg360,phy_name = "rtl8221b";
		reg = <0>;
		phy-mode = "sgmii";
		phy-handle = <&phy7>;
	};
	gmac4: mac@4 {
		compatible = "mediatek,eth-mac";
		fg360,phy_name = "rtl8211fs";
		reg = <1>;
		phy-mode = "sgmii";
		phy-handle = <&phy3>;
	};
	gmac5: mac@5 {
		compatible = "mediatek,eth-mac_def";
		fg360,phy_name = "MAC0";
		reg = <0>;
		phy-mode = "sgmii";
		fixed-link {
			speed = <1000>;
			full-duplex;
			pause;
		};
	};
	gmac6: mac@6 {
		compatible = "mediatek,eth-mac_def";
		fg360,phy_name = "MAC1";
		reg = <1>;
		phy-mode = "sgmii";
		fixed-link {
			speed = <1000>;
			full-duplex;
			pause;
		};
	};

	mdio: mdio-bus {
		#address-cells = <1>;
		#size-cells = <0>;
		phy1reset-gpios = <&pio 66 0>;
		phy2reset-gpios = <&pio 64 0>;
		/* RTL8221B - vendor DTB address */
		phy7: phy@7 {
			reg = <7>;
			phy-mode = "sgmii";
			compatible = "ethernet-phy-ieee802.3-c22";
		};
		//RTL8211FS
		phy3: phy@3 {
			reg = <3>;
			phy-mode = "sgmii";
			compatible = "ethernet-phy-ieee802.3-c22";
		};
		//AQR112C
		phy8: phy@8 {
			reg = <8>;
			phy-mode = "sgmii";
			compatible = "ethernet-phy-ieee802.3-c45";
		};
		//MT7531
		phy31: phy@31 {
			reg = <31>;
			phy-mode = "sgmii";
			compatible = "ethernet-phy-ieee802.3-c22";
		};
	};
};
/* END: support realtek eth phy,modify by haowei.cheng*/


&gsw {
	mediatek,mdio = <&mdio>;
	mediatek,mdio_master_pinmux = <0>;
	reset-gpios = <&pio 66 0>;
	interrupt-parent = <&pio>;
	interrupts = <65 IRQ_TYPE_LEVEL_HIGH>;

	status = "okay";

	port6: port@6 {
		compatible = "mediatek,mt753x-port";
		reg = <6>;
		phy-mode = "sgmii";
		fixed-link {
			speed = <2500>;
			full-duplex;
		};
	};
};

&pcie0 {
	max-link-speed = <2>;
	pinctrl-names = "default";
	pinctrl-0 = <&pcie0_pins_default>;
	status = "okay";
};

&pcie1 {
	max-link-speed = <2>;
	pinctrl-names = "default";
	pinctrl-0 = <&pcie1_pins_default>;
	status = "okay";
};

&pcie2 {
	max-link-speed = <3>;
	pinctrl-names = "default";
	pinctrl-0 = <&pcie2_pins_default>;
	status = "okay";
};

&pcie3 {
	max-link-speed = <3>;
	pinctrl-names = "default";
	pinctrl-0 = <&pcie3_pins_default>;
	status = "okay";
};

/*
&odm {
	vibrator0:vibrator@0 {
		compatible = "mediatek,vibrator";
		vib_timer = <25>;
		vib_limit = <9>;
		vib_vol= <9>;
	};
};*/

/*begin: add by laizhenhao for audio pinctrl*/
/* AUDIO GPIO standardization */
&afe {
	pinctrl-names = "aud_dat_miso_off", "aud_dat_miso_on",
			"aud_dat_mosi_off", "aud_dat_mosi_on",
			"aud_gpio_i2s0_off", "aud_gpio_i2s0_on",
			"aud_gpio_i2s1_off", "aud_gpio_i2s1_on",
			"aud_gpio_i2s2_off", "aud_gpio_i2s2_on",
			"aud_gpio_i2s3_off", "aud_gpio_i2s3_on",
            "aud_gpio_i2s4_off", "aud_gpio_i2s4_on",
			"aud_gpio_i2s5_off", "aud_gpio_i2s5_on",
			"aud_gpio_i2s6_off", "aud_gpio_i2s6_on",
			"vow_dat_miso_off", "vow_dat_miso_on",
			"vow_clk_miso_off", "vow_clk_miso_on",
			"aud_gpio_proslic_off", "aud_gpio_proslic_on",
			"aud_gpio_tdm_off", "aud_gpio_tdm_on";
	pinctrl-0 = <&aud_dat_mosi_off>;
	pinctrl-1 = <&aud_dat_mosi_on>;
	pinctrl-2 = <&aud_dat_miso_off>;
	pinctrl-3 = <&aud_dat_miso_on>;
	pinctrl-4 = <&aud_gpio_i2s0_off>;
	pinctrl-5 = <&aud_gpio_i2s0_on>;
	pinctrl-6 = <&aud_gpio_i2s1_off>;
	pinctrl-7 = <&aud_gpio_i2s1_on>;
	pinctrl-8 = <&aud_gpio_i2s2_off>;
	pinctrl-9 = <&aud_gpio_i2s2_on>;
	pinctrl-10 = <&aud_gpio_i2s3_off>;
	pinctrl-11 = <&aud_gpio_i2s3_on>;
	pinctrl-12 = <&aud_gpio_i2s4_off>;
	pinctrl-13 = <&aud_gpio_i2s4_on>;
	pinctrl-14 = <&aud_gpio_i2s5_off>;
	pinctrl-15 = <&aud_gpio_i2s5_on>;
	pinctrl-16 = <&aud_gpio_i2s6_off>;
	pinctrl-17 = <&aud_gpio_i2s6_on>;
	pinctrl-18 = <&vow_dat_miso_off>;
	pinctrl-19 = <&vow_dat_miso_on>;
	pinctrl-20 = <&vow_clk_miso_off>;
	pinctrl-21 = <&vow_clk_miso_on>;
	pinctrl-22 = <&aud_gpio_proslic_off>;
	pinctrl-23 = <&aud_gpio_proslic_on>;
	pinctrl-24 = <&aud_gpio_tdm_off>;
	pinctrl-25 = <&aud_gpio_tdm_on>;
	status = "okay";
};

&pio {
	/* set audio pinctrl status */
	aud_dat_mosi_off: aud_dat_mosi_off {
	};
	aud_dat_mosi_on: aud_dat_mosi_on {
	};
	aud_dat_miso_off: aud_dat_miso_off {
	};
	aud_dat_miso_on: aud_dat_miso_on {
	};
	vow_dat_miso_off: vow_dat_miso_off {
	};
	vow_dat_miso_on: vow_dat_miso_on {
	};
	vow_clk_miso_off: vow_clk_miso_off {
	};
	vow_clk_miso_on: vow_clk_miso_on {
	};
	aud_gpio_i2s0_off: aud_gpio_i2s0_off {
		pins_cmd0_dat {
			pinmux = <PINMUX_GPIO230__FUNC_GPIO230>;
			input-enable;
			bias-pull-down;
		};
		pins_cmd1_dat {
			pinmux = <PINMUX_GPIO231__FUNC_GPIO231>;
			input-enable;
			bias-pull-down;
		};
		pins_cmd2_dat {
			pinmux = <PINMUX_GPIO232__FUNC_GPIO232>;
			input-enable;
			bias-pull-down;
		};
		pins_cmd3_dat {
			pinmux = <PINMUX_GPIO233__FUNC_GPIO233>;
			input-enable;
			bias-pull-down;
		};
	};
	aud_gpio_i2s0_on: aud_gpio_i2s0_on {
		pins_cmd0_dat {
			pinmux = <PINMUX_GPIO230__FUNC_I2S0_MCK>;
			input-schmitt-enable;
			bias-disable;
		};
		pins_cmd1_dat {
			pinmux = <PINMUX_GPIO231__FUNC_I2S0_BCK>;
			input-schmitt-enable;
			bias-disable;
		};
		pins_cmd2_dat {
			pinmux = <PINMUX_GPIO232__FUNC_I2S0_LRCK>;
			input-schmitt-enable;
			bias-disable;
		};
		pins_cmd3_dat {
			pinmux = <PINMUX_GPIO233__FUNC_I2S0_DI>;
			input-schmitt-enable;
			bias-disable;
		};
	};
	aud_gpio_i2s1_off: aud_gpio_i2s1_off {
		pins_cmd0_dat {
			pinmux = <PINMUX_GPIO91__FUNC_GPIO91>;
			input-enable;
			bias-pull-down;
		};
		pins_cmd1_dat {
			pinmux = <PINMUX_GPIO92__FUNC_GPIO92>;
			input-enable;
			bias-pull-down;
		};
		pins_cmd2_dat {
			pinmux = <PINMUX_GPIO93__FUNC_GPIO93>;
			input-enable;
			bias-pull-down;
		};
		pins_cmd3_dat {
			pinmux = <PINMUX_GPIO95__FUNC_GPIO95>;
			input-enable;
			bias-pull-down;
		};
	};
	aud_gpio_i2s1_on: aud_gpio_i2s1_on {
		pins_cmd0_dat {
			pinmux = <PINMUX_GPIO91__FUNC_I2S2_MCK>;
			input-schmitt-enable;
			bias-disable;
		};
		pins_cmd1_dat {
			pinmux = <PINMUX_GPIO92__FUNC_I2S2_BCK>;
			input-schmitt-enable;
			bias-disable;
		};
		pins_cmd2_dat {
			pinmux = <PINMUX_GPIO93__FUNC_I2S2_LRCK>;
			input-schmitt-enable;
			bias-disable;
		};
		pins_cmd3_dat {
			pinmux = <PINMUX_GPIO95__FUNC_I2S1_DO>;
			input-schmitt-enable;
			bias-disable;
		};
	};
	aud_gpio_i2s2_off: aud_gpio_i2s2_off {
		pins_cmd0_dat {
			pinmux = <PINMUX_GPIO91__FUNC_GPIO91>;
			input-enable;
			bias-pull-down;
		};
		pins_cmd1_dat {
			pinmux = <PINMUX_GPIO92__FUNC_GPIO92>;
			input-enable;
			bias-pull-down;
		};
		pins_cmd2_dat {
			pinmux = <PINMUX_GPIO93__FUNC_GPIO93>;
			input-enable;
			bias-pull-down;
		};
		pins_cmd3_dat {
			pinmux = <PINMUX_GPIO94__FUNC_GPIO94>;
			input-enable;
			bias-pull-down;
		};
	};
	aud_gpio_i2s2_on: aud_gpio_i2s2_on {
		pins_cmd0_dat {
			pinmux = <PINMUX_GPIO91__FUNC_I2S2_MCK>;
			input-schmitt-enable;
			bias-disable;
		};
		pins_cmd1_dat {
			pinmux = <PINMUX_GPIO92__FUNC_I2S2_BCK>;
			input-schmitt-enable;
			bias-disable;
		};
		pins_cmd2_dat {
			pinmux = <PINMUX_GPIO93__FUNC_I2S2_LRCK>;
			input-schmitt-enable;
			bias-disable;
		};
		pins_cmd3_dat {
			pinmux = <PINMUX_GPIO94__FUNC_I2S2_DI>;
			input-schmitt-enable;
			bias-disable;
		};
	};
	aud_gpio_i2s3_off: aud_gpio_i2s3_off {
		pins_cmd0_dat {
			pinmux = <PINMUX_GPIO230__FUNC_GPIO230>;
			input-enable;
			bias-pull-down;
		};
		pins_cmd1_dat {
			pinmux = <PINMUX_GPIO231__FUNC_GPIO231>;
			input-enable;
			bias-pull-down;
		};
		pins_cmd2_dat {
			pinmux = <PINMUX_GPIO232__FUNC_GPIO232>;
			input-enable;
			bias-pull-down;
		};
		pins_cmd3_dat {
			pinmux = <PINMUX_GPIO234__FUNC_GPIO234>;
			input-enable;
			bias-pull-down;
		};
	};
	aud_gpio_i2s3_on: aud_gpio_i2s3_on {
		pins_cmd0_dat {
			pinmux = <PINMUX_GPIO230__FUNC_I2S0_MCK>;
			input-schmitt-enable;
			bias-disable;
		};
		pins_cmd1_dat {
			pinmux = <PINMUX_GPIO231__FUNC_I2S0_BCK>;
			input-schmitt-enable;
			bias-disable;
		};
		pins_cmd2_dat {
			pinmux = <PINMUX_GPIO232__FUNC_I2S0_LRCK>;
			input-schmitt-enable;
			bias-disable;
		};
		pins_cmd3_dat {
			pinmux = <PINMUX_GPIO234__FUNC_I2S0_DO>;
			input-schmitt-enable;
			bias-disable;
		};
	};
	aud_gpio_i2s4_off: aud_gpio_i2s4_off {
	};
	aud_gpio_i2s4_on: aud_gpio_i2s4_on {
	};
	aud_gpio_i2s5_off: aud_gpio_i2s5_off {
	};
	aud_gpio_i2s5_on: aud_gpio_i2s5_on {
	};
	aud_gpio_i2s6_off: aud_gpio_i2s6_off {
	};
	aud_gpio_i2s6_on: aud_gpio_i2s6_on {
	};

	aud_gpio_proslic_off: aud_gpio_proslic_off {
		pins_cmd_dat {
			pinmux = <PINMUX_GPIO231__FUNC_GPIO231>,
				 <PINMUX_GPIO232__FUNC_GPIO232>,
				 <PINMUX_GPIO233__FUNC_GPIO233>,
				 <PINMUX_GPIO234__FUNC_GPIO234>;
		};
	};
	aud_gpio_proslic_on: aud_gpio_proslic_on {
		pins_cmd_dat {
			pinmux = <PINMUX_GPIO231__FUNC_PCM1_CLK>,
				 <PINMUX_GPIO232__FUNC_PCM1_SYNC>,
				 <PINMUX_GPIO233__FUNC_PCM1_DI>,
				 <PINMUX_GPIO234__FUNC_PCM1_DO>;
		};
	};
	aud_gpio_tdm_off: aud_gpio_tdm_off {
		pins_cmd_dat {
			pinmux = <PINMUX_GPIO199__FUNC_GPIO199>,
				 <PINMUX_GPIO200__FUNC_GPIO200>,
				 <PINMUX_GPIO201__FUNC_GPIO201>,
				 <PINMUX_GPIO202__FUNC_GPIO202>,
				 <PINMUX_GPIO203__FUNC_GPIO203>,
				 <PINMUX_GPIO204__FUNC_GPIO204>,
				 <PINMUX_GPIO205__FUNC_GPIO205>;
		};
	};
	aud_gpio_tdm_on: aud_gpio_tdm_on {
		pins_cmd_dat {
			pinmux = <PINMUX_GPIO199__FUNC_TDM_LRCK>,
				 <PINMUX_GPIO200__FUNC_TDM_BCK>,
				 <PINMUX_GPIO201__FUNC_TDM_MCK>,
				 <PINMUX_GPIO202__FUNC_TDM_DATA0>,
				 <PINMUX_GPIO203__FUNC_TDM_DATA1>,
				 <PINMUX_GPIO204__FUNC_TDM_DATA2>,
				 <PINMUX_GPIO205__FUNC_TDM_DATA3>;
		};
	};
};
/* AUDIO GPIO standardization end */

/*end: add by laizhenhao for audio pinctrl*/

/* DISPSYS GPIO standardization */
#if 0
&pio {
	mtkfb_pins_lcd_bias_enp1: lcd_bias_enp1_gpio {
		pins_cmd_dat {
			pinmux = <PINMUX_GPIO28__FUNC_GPIO28>;
			slew-rate = <1>;
			output-high;
		};
	};

	mtkfb_pins_lcd_bias_enp0: lcd_bias_enp0_gpio {
		pins_cmd_dat {
			pinmux = <PINMUX_GPIO28__FUNC_GPIO28>;
			slew-rate = <1>;
			output-low;
		};
	};

	mtkfb_pins_lcd_bias_enn1: lcd_bias_enn1_gpio {
		pins_cmd_dat {
			pinmux = <PINMUX_GPIO29__FUNC_GPIO29>;
			slew-rate = <1>;
			output-high;
		};
	};

	mtkfb_pins_lcd_bias_enn0: lcd_bias_enn0_gpio {
		pins_cmd_dat {
			pinmux = <PINMUX_GPIO29__FUNC_GPIO29>;
			slew-rate = <1>;
			output-low;
		};
	};

	mtkfb_pins_lcm_rst_out1_gpio: lcm_rst_out1_gpio {
		pins_cmd_dat {
			pinmux = <PINMUX_GPIO42__FUNC_GPIO42>;
			slew-rate = <1>;
			output-high;
		};
	};

	mtkfb_pins_lcm_rst_out0_gpio: lcm_rst_out0_gpio {
		pins_cmd_dat {
			pinmux = <PINMUX_GPIO42__FUNC_GPIO42>;
			slew-rate = <1>;
			output-low;
		};
	};
	mtkfb_pins_lcm_dsi_te: lcm_dsi_te {
		pins_cmd_dat {
			pinmux = <PINMUX_GPIO41__FUNC_DSI_TE>;
		};
	};
};

&mtkfb {
	pinctrl-names = "lcd_bias_enp1_gpio", "lcd_bias_enp0_gpio",
		"lcd_bias_enn1_gpio", "lcd_bias_enn0_gpio",
		"lcm_rst_out1_gpio", "lcm_rst_out0_gpio",
		"mode_te_te";
	pinctrl-0 = <&mtkfb_pins_lcd_bias_enp1>;
	pinctrl-1 = <&mtkfb_pins_lcd_bias_enp0>;
	pinctrl-2 = <&mtkfb_pins_lcd_bias_enn1>;
	pinctrl-3 = <&mtkfb_pins_lcd_bias_enn0>;
	pinctrl-4 = <&mtkfb_pins_lcm_rst_out1_gpio>;
	pinctrl-5 = <&mtkfb_pins_lcm_rst_out0_gpio>;
	pinctrl-6 = <&mtkfb_pins_lcm_dsi_te>;
	status = "okay";
};
#endif


/*<!-- BEGIN: fibocom modified-->  */
&spi0 {
	status = "okay";
	#address-cells = <1>;
	#size-cells = <0>;

	/* AW1000 Ultra vendor hardware: ProSLIC is physically on SPI0 CS0. */
	proslic_spi: proslic_spi@0 {
		compatible = "silabs,proslic_spi";
		reg = <0>;
		spi-max-frequency = <24000000>;
		spi-cpha = <1>;
		spi-cpol = <1>;
		channel_count = <1>;
		debug_level = <7>;
		slic_interrupt = <&pio 24 0>;
		reset_gpio = <&pio 23 0>;
		ig,enable-spi = <1>;
	};
};
/*<!-- END: fibocom modified-->  */


&spi3 {
	status = "okay";
	#address-cells=<1>;
	#size-cells=<0>;
};

/*begin: modify audio codec function,by laizhenhao,2021.05.31*/
&i2c0 {
	status = "okay";
	#address-cells=<1>;
	#size-cells=<0>;

	nau88c22: nau88c22@1a {
		compatible = "nuvoton,nau88c22";
		reg = <0x1a>;
	};

};
/*end: modify audio codec function,by laizhenhao,2021.05.31*/

/* GPS GPIO standardization start */
#if 1
&pio {

	eth_gpio_default: mdio_default {
		mux {
			pinmux = <PINMUX_GPIO61__FUNC_GPIO61>;
		};
	};

	eth_smi_mdio_pinctl: eth_smi_mdio_pinctl {
		mux {
			pinmux = <PINMUX_GPIO61__FUNC_SMI_MDIO>;
		};
	};

	eth_smi_mdc_pinctl: eth_smi_mdc_pinctl {
		mux {
			pinmux = <PINMUX_GPIO62__FUNC_SMI_MDC>;
		};
	};

/* BEGIN: Remove unused device tree information,modify by haowei.cheng*/
#if 0
	eth_default: eth_default {
		txd_pins {
			pinmux = <PINMUX_GPIO8__FUNC_GBE_TXD3>,
				 <PINMUX_GPIO9__FUNC_GBE_TXD2>,
				 <PINMUX_GPIO10__FUNC_GBE_TXD1>,
				 <PINMUX_GPIO11__FUNC_GBE_TXD0>;
			drive-strength = <MTK_DRIVE_8mA>;
		};
		cc_pins {
			pinmux = <PINMUX_GPIO18__FUNC_GBE_TXC>,
				 <PINMUX_GPIO21__FUNC_GBE_TXEN>,
				 <PINMUX_GPIO20__FUNC_GBE_RXDV>,
				 <PINMUX_GPIO19__FUNC_GBE_RXC>;
			drive-strength = <MTK_DRIVE_8mA>;
		};
		rxd_pins {
			pinmux = <PINMUX_GPIO14__FUNC_GBE_RXD3>,
				 <PINMUX_GPIO15__FUNC_GBE_RXD2>,
				 <PINMUX_GPIO16__FUNC_GBE_RXD1>,
				 <PINMUX_GPIO17__FUNC_GBE_RXD0>;
		};
		mdio_pins {
			pinmux = <PINMUX_GPIO12__FUNC_GBE_MDC>,
				 <PINMUX_GPIO13__FUNC_GBE_MDIO>;
			input-enable;
		};
	};

	eth_sleep: eth_sleep {
		txd_pins {
			pinmux = <PINMUX_GPIO8__FUNC_GPIO8>,
				 <PINMUX_GPIO9__FUNC_GPIO9>,
				 <PINMUX_GPIO10__FUNC_GPIO10>,
				 <PINMUX_GPIO11__FUNC_GPIO11>;
		};
		cc_pins {
			pinmux = <PINMUX_GPIO18__FUNC_GPIO18>,
				 <PINMUX_GPIO21__FUNC_GPIO21>,
				 <PINMUX_GPIO20__FUNC_GPIO20>,
				 <PINMUX_GPIO19__FUNC_GPIO19>;
		};
		rxd_pins {
			pinmux = <PINMUX_GPIO14__FUNC_GPIO14>,
				 <PINMUX_GPIO15__FUNC_GPIO15>,
				 <PINMUX_GPIO16__FUNC_GPIO16>,
				 <PINMUX_GPIO17__FUNC_GPIO17>;
		};
		mdio_pins {
			pinmux = <PINMUX_GPIO12__FUNC_GPIO12>,
				 <PINMUX_GPIO13__FUNC_GPIO13>;
			input-disable;
			bias-disable;
		};
	};
#endif
/*END: Remove unused device tree information,modify by haowei.cheng*/

	pcie0_pins_default: pcie0-default {
		mux {
			pinmux = <PINMUX_GPIO67__FUNC_PCIE_PERESET_N_0P>,
			         <PINMUX_GPIO68__FUNC_PCIE_WAKE_N_0P>,
				 <PINMUX_GPIO69__FUNC_PCIE_CLKREQ_N_0P>;
			bias-pull-up;
		};
	};

	pcie1_pins_default: pcie1-default {
		mux {
			pinmux = <PINMUX_GPIO70__FUNC_PCIE_PERESET_N_1P>,
			         <PINMUX_GPIO71__FUNC_PCIE_WAKE_N_1P>,
				 <PINMUX_GPIO72__FUNC_PCIE_CLKREQ_N_1P>;
			bias-pull-up;
		};
	};

	pcie2_pins_default: pcie2-default {
		mux {
			pinmux = <PINMUX_GPIO73__FUNC_PCIE_PERESET_N_2P>,
			         <PINMUX_GPIO74__FUNC_PCIE_WAKE_N_2P>,
				 <PINMUX_GPIO75__FUNC_PCIE_CLKREQ_N_2P>;
			bias-pull-up;
		};
	};

	pcie3_pins_default: pcie3-default {
		mux {
			pinmux = <PINMUX_GPIO76__FUNC_PCIE_PERESET_N_3P>,
			         <PINMUX_GPIO77__FUNC_PCIE_WAKE_N_3P>,
				 <PINMUX_GPIO78__FUNC_PCIE_CLKREQ_N_3P>;
			bias-pull-up;
		};
	};

	gps_pins_default: gps_default {
	};

	gps_l1_lna_pins_ol: gps_l1_lna@0 {
		pins_cmd_dat {
			pinmux = <PINMUX_GPIO125__FUNC_GPIO125>;
			output-low;
		};
	};
	gps_l1_lna_pins_dsp_ctrl: gps_l1_lna@1 {
		pins_cmd_dat {
			pinmux = <PINMUX_GPIO125__FUNC_GPS_L1_ELNA_EN>;
		};
	};
	gps_l1_lna_pins_oh: gps_l1_lna@2 {
		pins_cmd_dat {
			pinmux = <PINMUX_GPIO125__FUNC_GPIO125>;
			output-high;
		};
	};

	gps_l5_lna_pins_ol: gps_l5_lna@0 {
		pins_cmd_dat {
			pinmux = <PINMUX_GPIO126__FUNC_GPIO126>;
			output-low;
		};
	};
	gps_l5_lna_pins_dsp_ctrl: gps_l5_lna@1 {
		pins_cmd_dat {
			pinmux = <PINMUX_GPIO126__FUNC_GPS_L5_ELNA_EN>;
		};
	};
	gps_l5_lna_pins_oh: gps_l5_lna@2 {
		pins_cmd_dat {
			pinmux = <PINMUX_GPIO126__FUNC_GPIO126>;
			output-high;
		};
	};
};

&gps {
	pinctrl-names = "default",
		"gps_l1_lna_disable",
		"gps_l1_lna_dsp_ctrl",
		"gps_l1_lna_enable",
		"gps_l5_lna_disable",
		"gps_l5_lna_dsp_ctrl",
		"gps_l5_lna_enable";
	pinctrl-0 = <&gps_pins_default>;
	pinctrl-1 = <&gps_l1_lna_pins_ol>;
	pinctrl-2 = <&gps_l1_lna_pins_dsp_ctrl>;
	pinctrl-3 = <&gps_l1_lna_pins_oh>;
	pinctrl-4 = <&gps_l5_lna_pins_ol>;
	pinctrl-5 = <&gps_l5_lna_pins_dsp_ctrl>;
	pinctrl-6 = <&gps_l5_lna_pins_oh>;
	status = "okay";
};
#endif
/* GPS GPIO standardization end */

/* usb typec swtich */
&pio {
	c1_active: c1_high {
		pins_cmd_dat {
			pinmux = <PINMUX_GPIO95__FUNC_GPIO95>;
			output-high;
		};
	};

	c2_active: c2_highz {
		pins_cmd_dat {
			pinmux = <PINMUX_GPIO94__FUNC_GPIO94>;
			input-enable;
			bias-disable;
		};
	};

	c1_sleep: c1_low {
		pins_cmd_dat {
			pinmux = <PINMUX_GPIO95__FUNC_GPIO95>;
			output-low;
		};
	};

	c2_sleep: c2_low {
		pins_cmd_dat {
			pinmux = <PINMUX_GPIO94__FUNC_GPIO94>;
			output-low;
		};
	};

	sel_up: sel_high {
		pins_cmd_dat {
			pinmux = <PINMUX_GPIO93__FUNC_GPIO93>;
			output-high;
		};
	};

	sel_down: sel_low {
		pins_cmd_dat {
			pinmux = <PINMUX_GPIO93__FUNC_GPIO93>;
			output-low;
		};
	};

	sw_enable: sw_enable {
		pins_cmd_dat {
			pinmux = <PINMUX_GPIO92__FUNC_GPIO92>;
			output-low;
		};
	};

	sw_disable: sw_disable {
		pins_cmd_dat {
			pinmux = <PINMUX_GPIO92__FUNC_GPIO92>;
			output-low;
		};
	};
	kpd_gpios_def_cfg: kpdgpiodefault {
		pins_cmd_dat {
			pinmux = <PINMUX_GPIO114__FUNC_KPROW0>,
				<PINMUX_GPIO115__FUNC_KPROW1>;
			mediatek,pull-down-adv = <MTK_PUPD_SET_R1R0_01>;
			output-low;
			input-schmitt-enable;
		};
	};
};

&keypad {
	mediatek,key-debounce-ms = <1024>;
	/*HW Keycode [0~71] -> Linux Keycode*/
	mediatek,hw-map-num = <72>;
	mediatek,hw-init-map = <0 0 114 0 0 0 0 0 0 0 0 0 0 0 0 115 0 0 0 0 0 0 0
		0 0 0 0 0 112 0 0 0 0 0 0 0 0 0 0 0 0 0 0 0 0 0 0 0 0 0 0 0 0 0 0
		0 0 0 0 0 0 0 0 0 0 0 0 0 0 0 0 0 >;
	status = "okay";
	pinctrl-names = "default";
	pinctrl-0 = <&kpd_gpios_def_cfg>;
};

&typec_switch {
	switch-names = "ptn36241g","fusb304";
	pinctrl-names = "c1_active", "c1_sleep",
		"c2_active", "c2_sleep",
		"sel_up", "sel_down",
		"enable", "disable";
	/* ptn36241g */
	pinctrl-0 = <&c1_active>;
	pinctrl-1 = <&c1_sleep>;
	pinctrl-2 = <&c2_active>;
	pinctrl-3 = <&c2_sleep>;
	/* fusb304 */
	pinctrl-4 = <&sel_up>;
	pinctrl-5 = <&sel_down>;
	pinctrl-6 = <&sw_enable>;
	pinctrl-7 = <&sw_disable>;
};

&extcon_usb {
	vbus-supply = <&otg_vbus>;
	vbus-voltage = <5000000>;
	vbus-current = <1800000>;
};

&rt1711_typec {
	switch = <&typec_switch>;
};

/*BEGIN: add by ranxuefeng for HW version*/
&fibocom_pcb_version_ctrl_pin {
	status = "okay";
	pinctrl-names = "pcb_pin_1st_pullup", "pcb_pin_1st_pulldown", "pcb_pin_2nd_pullup", "pcb_pin_2nd_pulldown";
	pinctrl-0 = <&pcb_pin_1st_pullup_default>;
	pinctrl-1 = <&pcb_pin_1st_pulldown_default>;
	pinctrl-2 = <&pcb_pin_2nd_pullup_default>;
	pinctrl-3 = <&pcb_pin_2nd_pulldown_default>;
};
	
&pio {
	pcb_pin_1st_pullup_default: pcb_pin_1st_pullup-config {
		pins_cmd_dat {
			pinmux = <PINMUX_GPIO151__FUNC_GPIO151>;
			bias-pull-up;     
		};
	};
	
	pcb_pin_1st_pulldown_default: pcb_pin_1st_pulldown-config {
		pins_cmd_dat {
			pinmux = <PINMUX_GPIO151__FUNC_GPIO151>;
			bias-pull-down;     
		};
	};
	
	pcb_pin_2nd_pullup_default: pcb_pin_2nd_pullup-config {
		pins_cmd_dat {
			pinmux = <PINMUX_GPIO163__FUNC_GPIO163>;
			bias-pull-up;     
		};
	};
	
	pcb_pin_2nd_pulldown_default: pcb_pin_2nd_pulldown-config {
		pins_cmd_dat {
			pinmux = <PINMUX_GPIO163__FUNC_GPIO163>;
			bias-pull-down;     
		};
	};
	
};
/*END: add by ranxuefeng for HW version*/

/*BEGIN: add by chenmaming for rf set*/
&fibocom_rf_set_ctrl_pin {
	status = "okay";
	pinctrl-names = "rf_set_pin_1st_pullup", "rf_set_pin_1st_pulldown", "rf_set_pin_2nd_pullup", "rf_set_pin_2nd_pulldown";
	pinctrl-0 = <&rf_set_pin_1st_pullup_default>;
	pinctrl-1 = <&rf_set_pin_1st_pulldown_default>;
	pinctrl-2 = <&rf_set_pin_2nd_pullup_default>;
	pinctrl-3 = <&rf_set_pin_2nd_pulldown_default>;
};
	
&pio {
	rf_set_pin_1st_pullup_default: rf_set_pin_1st_pullup-config {
		pins_cmd_dat {
			pinmux = <PINMUX_GPIO142__FUNC_GPIO142>;
			bias-pull-up;     
		};
	};
	
	rf_set_pin_1st_pulldown_default: rf_set_pin_1st_pulldown-config {
		pins_cmd_dat {
			pinmux = <PINMUX_GPIO142__FUNC_GPIO142>;
			bias-pull-down;     
		};
	};
	
	rf_set_pin_2nd_pullup_default: rf_set_pin_2nd_pullup-config {
		pins_cmd_dat {
			pinmux = <PINMUX_GPIO143__FUNC_GPIO143>;
			bias-pull-up;     
		};
	};
	
	rf_set_pin_2nd_pulldown_default: rf_set_pin_2nd_pulldown-config {
		pins_cmd_dat {
			pinmux = <PINMUX_GPIO143__FUNC_GPIO143>;
			bias-pull-down;     
		};
	};
	
};
/*END: add by chenmaming for rf set*/

/*************************
 * PMIC LED DTSI File
*************************/
// Begin: FG360 boot time management, Add by Shuai Liu, 2021.06.11
&pmic {
	mt6330-led {
		compatible = "mediatek,mt6330_leds";
		Isink1 {
			reg = <1>;
			label = "led9515:green:cellular-radio";
			linux,default-trigger = "none";
			default-state = "off";
		};
	};
};
// End: FG360 boot time management, Add by Shuai Liu, 2021.06.11

&gpio_leds {
	led0 {
		label = "gpio4_LED_INTERNET";
		gpios = <&pio 4 GPIO_ACTIVE_HIGH>;
		linux,default-trigger = "none";
		default-state = "off";
	};
	led1 {
		label = "gpio5_LED_WIFI_G";
		gpios = <&pio 5 GPIO_ACTIVE_HIGH>;
		linux,default-trigger = "none";
		default-state = "off";
	};
	led2 {
		label = "gpio8_LED_SYS_G";
		gpios = <&pio 8 GPIO_ACTIVE_HIGH>;
		linux,default-trigger = "timer";
		default-state = "on";
	};
	led3 {
		label = "gpio21_LED_FXS_G";
		gpios = <&pio 21 GPIO_ACTIVE_HIGH>;
		linux,default-trigger = "none";
		default-state = "off";
	};
	led4 {
		label = "gpio22_LED_5G_G";
		gpios = <&pio 22 GPIO_ACTIVE_HIGH>;
		linux,default-trigger = "none";
		default-state = "off";
	};
	led5 {
		label = "gpio25_LED_MOBILE_R";
		gpios = <&pio 25 GPIO_ACTIVE_HIGH>;
		linux,default-trigger = "none";
		default-state = "off";
	};
	led6 {
		label = "gpio26_LED_FXS_R";
		gpios = <&pio 26 GPIO_ACTIVE_HIGH>;
		linux,default-trigger = "none";
		default-state = "off";
	};
	led7 {
		label = "gpio27_LED_MOBILE_G";
		gpios = <&pio 27 GPIO_ACTIVE_HIGH>;
		linux,default-trigger = "none";
		default-state = "off";
	};
	led8 {
		label = "gpio28_LED_SYS_R";
		gpios = <&pio 28 GPIO_ACTIVE_HIGH>;
		linux,default-trigger = "none";
		default-state = "off";
	};
	led9 {
		label = "gpio29_LED_WIFI_R";
		gpios = <&pio 29 GPIO_ACTIVE_HIGH>;
		linux,default-trigger = "none";
		default-state = "off";
	};
};

/*begin: add for RST WPS button by laizhenhao,2021.3.27*/

/* DOTY-AW1000-STAGE3-BUTTON-PINCTRL-BEGIN */
&pio {
	arc_btn_pin: arc_btn_pin {
		pins_cmd_dat {
			pinmux = <0x700 0xa00 0x1400>;
			mediatek,pull-up-adv = <0x65>;
			pull-up;
			input-enable;
		};
	};
};
/* DOTY-AW1000-STAGE3-BUTTON-PINCTRL-END */

&gpio_keys {
	pinctrl-names = "default";
	pinctrl-0 = <&arc_btn_pin>;

	/delete-node/ button0;
	/delete-node/ button1;

	btn_reset {
		label = "reset";
		gpios = <&pio 7 GPIO_ACTIVE_LOW>;
		linux,code = <408>;
	};
	btn_wlan {
		label = "wlan";
		gpios = <&pio 10 GPIO_ACTIVE_LOW>;
		linux,code = <238>;
	};
	btn_wps {
		label = "wps";
		gpios = <&pio 20 GPIO_ACTIVE_LOW>;
		linux,code = <529>;
	};
};
/*end: add for RST WPS button by laizhenhao,2021.3.27*/

#include <mediatek/evb6890v1_64_cpe/cust.dtsi>
/*End of this file, DO NOT ADD ANYTHING HERE*/

/* DOTY-LK-VENDOR-DTB-PARITY-BEGIN */
/*
 * Exact semantic closure against vendor lk_main_dtb.
 * Main LK binary is not modified here.
 */

/ {
	/delete-node/ pwrap@1000d000;

};

&i2c0 {
	/delete-property/ status;
	/delete-node/ nau88c22@1a;
};

&spi3 {
	/delete-property/ status;
	/delete-property/ #address-cells;
	/delete-property/ #size-cells;
};
/* DOTY-LK-VENDOR-DTB-PARITY-END */

/* DOTY-LK-VENDOR-PHANDLE-PARITY-BEGIN */
/*
 * Binary-parity only.
 * Hardware/node/property semantics already match vendor.
 * These explicit phandles reproduce vendor LK DTB numbering.
 */
&{/auxadc@11001000} {
	phandle = <0x141>;
};

&{/clkao} {
	phandle = <0xcb>;
};

&{/clocks/clk10m} {
	phandle = <0xcd>;
};

&{/clocks/clk12m} {
	phandle = <0xce>;
};

&{/clocks/clk_null} {
	phandle = <0xcc>;
};

&{/clocks/ulposc} {
	phandle = <0xcf>;
};

&{/cpupm-sysram@0011b000} {
	phandle = <0xd6>;
};

&{/crypto@10320000} {
	phandle = <0x14e>;
};

&{/dbi0@1400f000} {
	phandle = <0x159>;
};

&{/dcm@10001000} {
	phandle = <0xef>;
};

&{/dispsys} {
	phandle = <0x15b>;
};

&{/dpmaif@10014000} {
	phandle = <0x127>;
};

&{/dramc@10230000} {
	phandle = <0x128>;
};

&{/dsi0@1400e000} {
	phandle = <0x156>;
};

&{/dsi_te} {
	phandle = <0x15a>;
};

&{/emiisu} {
	phandle = <0x129>;
};

&{/emimpu@10226000} {
	phandle = <0x125>;
};

&{/ethernet@11021000} {
	phandle = <0x12a>;
};

&{/ethernet@15100000} {
	phandle = <0x146>;
};

&{/ethernet@15100000/mac@0} {
	phandle = <0x147>;
};

&{/ethernet@15100000/mac@1} {
	phandle = <0x148>;
};

&{/ethernet@15100000/mac@3} {
	phandle = <0x149>;
};

&{/ethernet@15100000/mac@4} {
	phandle = <0x14a>;
};

&{/ethernet@15100000/mac@5} {
	phandle = <0x14b>;
};

&{/ethernet@15100000/mac@6} {
	phandle = <0x14c>;
};

&{/ethernet@15100000/mdio-bus/phy@31} {
	phandle = <0x14d>;
};

&{/extcon_usb} {
	phandle = <0x167>;
};

&{/fibocom_pcb_version_ctrl_pin} {
	phandle = <0xf2>;
};

&{/fibocom_rf_set_ctrl_pin} {
	phandle = <0xf3>;
};

&{/gpio@10005000} {
	phandle = <0xf1>;
};

&{/gpio_keys} {
	phandle = <0xf7>;
};

&{/gpio_usage_mapping} {
	phandle = <0xf0>;
};

&{/gps@18C00000} {
	phandle = <0x162>;
};

&{/gsw@0} {
	phandle = <0x16a>;
};

&{/gsw@0/port@6} {
	phandle = <0x16b>;
};

&{/hwrng} {
	phandle = <0x124>;
};

&{/i2c0@11c40000} {
	phandle = <0x12c>;
};

&{/i2c1@11c41000} {
	phandle = <0x12d>;
};

&{/i2c1@11c41000/alsps@60} {
	phandle = <0x131>;
};

&{/i2c1@11c41000/barometer@76} {
	phandle = <0x12e>;
};

&{/i2c1@11c41000/gsensor@6a} {
	phandle = <0x130>;
};

&{/i2c1@11c41000/msensor@0c} {
	phandle = <0x12f>;
};

&{/i2c2@11c42000} {
	phandle = <0x132>;
};

&{/i2c2@11c42000/buck_boost@39} {
	phandle = <0x135>;
};

&{/i2c2@11c42000/rt9467@5b} {
	phandle = <0x133>;
};

&{/i2c2@11c42000/slave_charger@5b} {
	phandle = <0x134>;
};

&{/i2c3@11c43000} {
	phandle = <0x136>;
};

&{/i2c3@11c43000/direct_charger_1@55} {
	phandle = <0x138>;
};

&{/i2c3@11c43000/usb_type_c@4e} {
	phandle = <0x137>;
};

&{/i2c4@11c44000} {
	phandle = <0x139>;
};

&{/i2c5@11c45000} {
	phandle = <0x13a>;
};

&{/i2c5@11c45000/cap_touch@5d} {
	phandle = <0x13c>;
};

&{/i2c5@11c45000/i2c_lcd_bias@3e} {
	phandle = <0x13b>;
};

&{/i2c_common} {
	phandle = <0x12b>;
};

&{/iocfg_tl@0x11f00000} {
	phandle = <0x157>;
};

&{/mcusys-ctrl@0c53a000} {
	phandle = <0xd7>;
};

&{/medmcu@15f00000} {
	phandle = <0x161>;
};

&{/mhccif@10024000} {
	phandle = <0xf9>;
};

&{/mmc@11230000} {
	phandle = <0x14f>;
};

&{/mmc@11240000} {
	phandle = <0x150>;
};

&{/mrdump_ext_rst} {
	phandle = <0x126>;
};

&{/mtk_lpm} {
	phandle = <0xd4>;
};

&{/mtk_lpm/lpm_sysram@0011b500} {
	phandle = <0xd5>;
};

&{/mutt} {
	phandle = <0xd9>;
};

&{/nfi@11005000} {
	phandle = <0x145>;
};

&{/nli_arb@0x11f30000} {
	phandle = <0x158>;
};

&{/odm} {
	phandle = <0x163>;
};

&{/pcie@11280000} {
	phandle = <0x152>;
};

&{/pcie@11288000} {
	phandle = <0x153>;
};

&{/pcie@11290000} {
	phandle = <0x154>;
};

&{/pcie@11298000} {
	phandle = <0x155>;
};

&{/pcie_ep@11280000} {
	phandle = <0x151>;
};

&{/pmic_clock_buffer_ctrl} {
	phandle = <0x164>;
};

&{/ptn5150a_type_c_port0} {
	phandle = <0x169>;
};

&{/rt1711_type_c_port0} {
	phandle = <0x168>;
};

&{/scg-off} {
	phandle = <0xe2>;
};

&{/scg-off/scg-off-pa2} {
	phandle = <0xe3>;
};

&{/serial@11002000} {
	phandle = <0x142>;
};

&{/serial@11003000} {
	phandle = <0x143>;
};

&{/serial@11004000} {
	phandle = <0x144>;
};

&{/smart_pa} {
	phandle = <0x166>;
};

&{/sound} {
	phandle = <0x165>;
};

&{/spi0@1100a000} {
	phandle = <0x15c>;
};

&{/spi1@11010000} {
	phandle = <0x15d>;
};

&{/spi2@11012000} {
	phandle = <0x15e>;
};

&{/spi3@11013000} {
	phandle = <0x15f>;
};

&{/spi@11014000} {
	phandle = <0x160>;
};

&{/spmi@10026000/md1_sim1_hot_plug_eint} {
	phandle = <0xfb>;
};

&{/spmi@10026000/md1_sim2_hot_plug_eint} {
	phandle = <0xfc>;
};

&{/spmi@10026000/mt6315@5} {
	phandle = <0xfa>;
};

&{/spmi@10026000/mt6330} {
	phandle = <0xfd>;
};

&{/spmi@10026000/mt6330/clock_buffer_ctrl} {
	phandle = <0x11c>;
};

&{/spmi@10026000/mt6330/mt6330keys} {
	phandle = <0x11b>;
};

&{/spmi@10026000/mt6330/mt6330regulator} {
	phandle = <0xfe>;
};

&{/spmi@10026000/mt6330/mt6330regulator/buck_vmd11} {
	phandle = <0x103>;
};

&{/spmi@10026000/mt6330/mt6330regulator/buck_vmd12} {
	phandle = <0x100>;
};

&{/spmi@10026000/mt6330/mt6330regulator/buck_vrfdig} {
	phandle = <0x101>;
};

&{/spmi@10026000/mt6330/mt6330regulator/buck_vs1} {
	phandle = <0xff>;
};

&{/spmi@10026000/mt6330/mt6330regulator/buck_vs2} {
	phandle = <0x102>;
};

&{/spmi@10026000/mt6330/mt6330regulator/buck_vs3} {
	phandle = <0x105>;
};

&{/spmi@10026000/mt6330/mt6330regulator/buck_vsram_md} {
	phandle = <0x104>;
};

&{/spmi@10026000/mt6330/mt6330regulator/ldo_va12_1} {
	phandle = <0x119>;
};

&{/spmi@10026000/mt6330/mt6330regulator/ldo_va12_2} {
	phandle = <0x112>;
};

&{/spmi@10026000/mt6330/mt6330regulator/ldo_vaux18} {
	phandle = <0x10b>;
};

&{/spmi@10026000/mt6330/mt6330regulator/ldo_vbbck} {
	phandle = <0x118>;
};

&{/spmi@10026000/mt6330/mt6330regulator/ldo_vcn18} {
	phandle = <0x10a>;
};

&{/spmi@10026000/mt6330/mt6330regulator/ldo_vefuse} {
	phandle = <0x110>;
};

&{/spmi@10026000/mt6330/mt6330regulator/ldo_vio18_1} {
	phandle = <0x111>;
};

&{/spmi@10026000/mt6330/mt6330regulator/ldo_vio18_2} {
	phandle = <0x108>;
};

&{/spmi@10026000/mt6330/mt6330regulator/ldo_vmdd2} {
	phandle = <0x109>;
};

&{/spmi@10026000/mt6330/mt6330regulator/ldo_vmddq} {
	phandle = <0x117>;
};

&{/spmi@10026000/mt6330/mt6330regulator/ldo_vmddr} {
	phandle = <0x115>;
};

&{/spmi@10026000/mt6330/mt6330regulator/ldo_vrf09} {
	phandle = <0x114>;
};

&{/spmi@10026000/mt6330/mt6330regulator/ldo_vrf13} {
	phandle = <0x10d>;
};

&{/spmi@10026000/mt6330/mt6330regulator/ldo_vrf18} {
	phandle = <0x116>;
};

&{/spmi@10026000/mt6330/mt6330regulator/ldo_vrfck} {
	phandle = <0x106>;
};

&{/spmi@10026000/mt6330/mt6330regulator/ldo_vsim1} {
	phandle = <0x107>;
};

&{/spmi@10026000/mt6330/mt6330regulator/ldo_vsim2} {
	phandle = <0x11a>;
};

&{/spmi@10026000/mt6330/mt6330regulator/ldo_vsram_core} {
	phandle = <0x10c>;
};

&{/spmi@10026000/mt6330/mt6330regulator/ldo_vsram_proc} {
	phandle = <0x10e>;
};

&{/spmi@10026000/mt6330/mt6330regulator/ldo_vsram_rfdig} {
	phandle = <0x113>;
};

&{/spmi@10026000/mt6330/mt6330regulator/ldo_vxo22} {
	phandle = <0x10f>;
};

&{/spmi@10026000/mt6330/mt6330rtc} {
	phandle = <0x11d>;
};

&{/spmi@10026000/mt6330/mt6330rtc/ext_32k} {
	phandle = <0x120>;
};

&{/spmi@10026000/mt6330/mt6330rtc/fg_init} {
	phandle = <0x11e>;
};

&{/spmi@10026000/mt6330/mt6330rtc/fg_soc} {
	phandle = <0x11f>;
};

&{/spmi@10026000/mt6330/mt63xx-ot-debug} {
	phandle = <0x121>;
};

&{/spmi_p@10027000} {
	phandle = <0x122>;
};

&{/spmi_p@10027000/mt6330-spmi_p} {
	phandle = <0x123>;
};

&{/spmtwam@10006000} {
	phandle = <0xf4>;
};

&{/srclken@10006500} {
	phandle = <0xf5>;
};

&{/subpmic_pmu_eint} {
	phandle = <0x16c>;
};

&{/syscon@0d0a0000} {
	phandle = <0xd1>;
};

&{/syscon@10003000} {
	phandle = <0xd2>;
};

&{/syscon@1000c000} {
	phandle = <0xd0>;
};

&{/syscon@10228000} {
	phandle = <0xd3>;
};

&{/tcpc_pd_eint} {
	phandle = <0x16d>;
};

&{/thermal-zones/conn_gps/trips/consys_max_crit@0} {
	phandle = <0xed>;
};

&{/thermal-zones/crystal/trips/crystal_crit@0} {
	phandle = <0xea>;
};

&{/thermal-zones/ltepa_ntc/trips/ltepa_ntc_trip@2} {
	phandle = <0xe8>;
};

&{/thermal-zones/md_rf/trips/md_rf_crit@0} {
	phandle = <0xec>;
};

&{/thermal-zones/nrpa_ntc/trips/nrpa_ntc_trip@2} {
	phandle = <0xe7>;
};

&{/thermal-zones/pmic/trips/pmic_temp_crit@0} {
	phandle = <0xeb>;
};

&{/thermal-zones/rf_ntc/trips/rf_ntc_crit@0} {
	phandle = <0xe9>;
};

&{/thermal-zones/soc_dram_ntc/trips/soc_dram_ntc_crit@0} {
	phandle = <0xe6>;
};

&{/thermal-zones/soc_max/trips/soc_max_crit@0} {
	phandle = <0xe5>;
};

&{/thermal-zones/soc_max/trips/trip-point@0} {
	phandle = <0xe4>;
};

&{/thermal_risk_monitor} {
	phandle = <0xd8>;
};

&{/timer} {
	phandle = <0xf8>;
};

&{/topckgen@10000000} {
	phandle = <0xee>;
};

&{/tx-pwr} {
	phandle = <0xdf>;
};

&{/tx-pwr/tx-pwr-pa1} {
	phandle = <0xe0>;
};

&{/tx-pwr/tx-pwr-pa2} {
	phandle = <0xe1>;
};

&{/usb-phy} {
	phandle = <0x13e>;
};

&{/usb-phy/usb-phy@0} {
	phandle = <0x13f>;
};

&{/usb-phy@11e30000} {
	phandle = <0x140>;
};

&{/usb@11201000/xhci0@11200000} {
	phandle = <0x13d>;
};

&{/watchdog@10007000} {
	phandle = <0xf6>;
};

/* DOTY-LK-VENDOR-PHANDLE-PARITY-END */
